## meta-telematics/conf/layer.conf
```bitbake
BBPATH .= ":${LAYERDIR}"
BBFILES += "${LAYERDIR}/recipes-*/*/*.bb ${LAYERDIR}/recipes-*/*/*.bbappend"

BBFILE_COLLECTIONS += "telematics"
BBFILE_PATTERN_telematics = "^${LAYERDIR}/"
BBFILE_PRIORITY_telematics = "10"

LAYERSERIES_COMPAT_telematics = "kirkstone scarthgap"
LAYERDEPENDS_telematics = "core openembedded-layer networking-layer \
    meta-python virtualization-layer freescale-layer"
```
